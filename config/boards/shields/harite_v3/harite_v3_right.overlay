#include "harite_v3.dtsi"

&default_transform {
    col-offset = <6>; // Add offset to right side when right side is peripheral
};

&glidepoint_split {
    device = <&glidepoint>;
    status = "okay";
};
