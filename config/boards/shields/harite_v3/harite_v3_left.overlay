#include "harite_v3.dtsi"
#include <dt-bindings/zmk/input_transform.h>

&default_transform {
    col-offset = <0>; // Remove offset from left side when left is main/central
};

&glidepoint_listener {
    status = "okay";
    input-processors =
        <&zip_xy_transform (INPUT_TRANSFORM_Y_INVERT)>
        , <&zip_xy_scaler 1 10>
        , <&zip_xy_to_scroll_mapper>;  // Left trackpad now scrolls
};

&glidepoint_split_listener {
    status = "okay";
    input-processors =
        <&zip_xy_scaler 2 1>;  // Right trackpad now does cursor movement
};

