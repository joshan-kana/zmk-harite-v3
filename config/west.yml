## config/west.yml
```yaml
manifest:
  remotes:
    - name: zmkfirmware
      url-base: https://github.com/zmkfirmware
    - name: badjeff
      url-base: https://github.com/badjeff
    - name: dlip
      url-base: https://github.com/dlip
    - name: petejohanson
      url-base: https://github.com/petejohanson
  projects:
    - name: zmk-keyboard-harite-v3
      remote: dlip
      revision: 3823f672dd99317f5d360d1deac365cfbc80efb3  # main
    - name: zmk-analog-input-driver
      remote: badjeff
      revision: d07aedb66801598c0c278e60565bd8f6ab42f9b2  # main
    - name: cirque-input-module
      remote: petejohanson
      revision: 0de55f36bc720b5be3d8880dc856d4d78baf5214  # main
    - name: zmk-pmw3610-driver
      remote: badjeff
      revision: 72280acc8e4467ed1b4947ee216c6bf31d0278b2  # main
    - name: zmk
      remote: dlip
      revision: eeac4c3a53e6945281d5e2bb189c94b2c0bbce45  # main
      import: app/west.yml
    - name: zephyr
      remote: zmkfirmware
      revision: 628a0d85e36938dddb6f0dfc6dc902de7359711c  # v3.5.0+zmk-fixes
      import:
        name-blocklist:
          - ci-tools
          - hal_altera
          - hal_cypress
          - hal_infineon
          - hal_microchip
          - hal_nxp
          - hal_openisa
          - hal_silabs
          - hal_xtensa
          - hal_st
          - hal_ti
          - loramac-node
          - mcuboot
          - mcumgr
          - net-tools
          - openthread
          - edtt
          - trusted-firmware-m
  self:
    path: config
```
